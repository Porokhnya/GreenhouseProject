
//----------------------------------------------------------------------------------------------------------------
#include "OneWireHub.h"
#include "DS18B20.h"  // Digital Thermometer, 12bit
#include <PWM.h>

// ----------------------------------------------------------------------------------------------------------------
/*
 ПРОШИВКА ДЛЯ ОПРОСА ЕМКОСТНОГО ДАТЧИКА ВЛАЖНОСТИ ПОЧВЫ, ПРИНИМАЮЩЕГО НА ВХОД СИГНАЛ PWM, И
 ВЫДАЮЩИЙ ЗНАЧЕНИЕ ВЛАЖНОСТИ ПОЧВЫ.
 
 ПРОШИВКА ВЫДАЁТ НАРУЖУ ПОКАЗАНИЯ, ПРИКИДЫВАЯСЬ ДАТЧИКОМ DS18B20. ДЛЯ НАСТРОЙКИ ТАКОГО МОДУЛЯ
 НЕОБХОДИМО ПОДКЛЮЧИТЬ ЕГО К ЛИНИИ 1-WIRE КОНТРОЛЛЕРА, ЗАЙТИ В ОКНО "ПРИВЯЗКИ ЖЕЛЕЗА" КОНФИГУРАТОРА,
 И НА СТРАНИЦЕ "ЭМУЛЯТОРЫ DS18B20" УКАЗАТЬ НОМЕР ПИНА, К КОТОРОМУ ПОДКЛЮЧЕН МОДУЛЬ, УКАЗАТЬ, ЧТО ЭТО
 ДАТЧИК ВЛАЖНОСТИ ПОЧВЫ, И УКАЗАТЬ РЕЗУЛЬТИРУЮЩИЙ ИНДЕКС ДАТЧИКА (НАПРИМЕР, 0 - ДЛЯ ПЕРВОГО ТАКОГО ДАТЧИКА НА ЛИНИИ,
 1 - ДЛЯ ВТОРОГО И Т.Д.)
 
 Пины, которые использует плата модуля с датчиками:

  D2 - линия регистрации модуля в системе (1-Wire)
  D3 - линия генерации частоты емкостного сенсора
  A0 - чтение показаний с аналогового датчика влажности
 */

//----------------------------------------------------------------------------------------------------------------
// НАСТРОЙКИ ПРОШИВКИ
//----------------------------------------------------------------------------------------------------------------
#define _DEBUG // раскомментировать для отладочного режима (плюётся в Serial, )
#define ONEWIRE_PIN                   2 // номер пина 1-Wire
#define PWM_PIN                       3 // номер пина, на котором будем управлять частотой
#define SENSOR_PIN                    A0 // номер пина, с которого читаются показания датчика
#define SENSOR_UPDATE_INTERVAL        2000 // интервал обновления данных с датчика, миллисекунд
#define FREQUENCY                     2000000ul   // частота  1 - 2000000 (Гц)
#define PWM_VALUE                     150         // частота ШИМ (0-255)
#define SOIL_MOISTURE_0_PERCENT 1023 // значение АЦП для 0% влажности почвы (0-1023)
#define SOIL_MOISTURE_100_PERCENT 450 // значение АЦП для 100% влажности почвы (0-1023)

// АДРЕС МОДУЛЯ НА ЛИНИИ 1-WIRE МЕНЯТЬ ЗДЕСЬ! ЗНАЧЕНИЕ ПОСЛЕДНЕГО БАЙТА ПЕРЕД ЗАКРЫВАЮЩЕЙ СКОБКОЙ (например, сменить 0x00 на 0x01 и т.п.)
// КАЖДЫЙ ДАТЧИК НА ОДНОЙ ЛИНИИ 1-WIRE ОБЯЗАН ИМЕТЬ УНИКАЛЬНЫЙ АДРЕС !!!
auto ds18b20 = DS18B20(DS18B20::family_code, 0x00, 0x00, 0xB2, 0x18, 0xDA, 0x00);   // DS18B20: 9-12bit, -55 -  +85 degC
//----------------------------------------------------------------------------------------------------------------
// ||
// ||
// ||
// ||
// ||
// ||
// ||
// ||
// ||
// ||
// ||
// ||
// ||
// ||
// ||
// ||
// ||
// ||
// ||
// ||
// ||
// ||
// ||
// ||
// ||
// ||
// ||
// ||
// ||
// ||
// ||
// ||
// ||
// ||
// ||
// ||
// ||
// ||
// ||
// ||
// \/
//----------------------------------------------------------------------------------------------------------------
#define NO_TEMPERATURE_DATA -128 // нет данных с датчика температуры или влажности
constexpr uint8_t pin_onewire{ ONEWIRE_PIN };
auto hub = OneWireHub(pin_onewire);
uint32_t sensorUpdateTimer = 0;
//----------------------------------------------------------------------------------------------------------------
float ReadSensor()
{
	int val = analogRead(SENSOR_PIN);

#ifdef _DEBUG
	Serial.print(F("Val: "));
	Serial.println(val);
#endif  

   val = constrain(val,min(SOIL_MOISTURE_0_PERCENT,SOIL_MOISTURE_100_PERCENT),max(SOIL_MOISTURE_0_PERCENT,SOIL_MOISTURE_100_PERCENT));

   int percentsInterval = map(val,min(SOIL_MOISTURE_0_PERCENT,SOIL_MOISTURE_100_PERCENT),max(SOIL_MOISTURE_0_PERCENT,SOIL_MOISTURE_100_PERCENT),0,10000);
   
  // теперь, если у нас значение 0% влажности больше, чем значение 100% влажности - надо от 10000 отнять полученное значение
  if(SOIL_MOISTURE_0_PERCENT > SOIL_MOISTURE_100_PERCENT)
    percentsInterval = 10000 - percentsInterval;

   int8_t sensorValue;
   byte sensorFract;

   sensorValue = percentsInterval/100;
   sensorFract = percentsInterval%100;

   if(sensorValue > 99)
   {
      sensorValue = 100;
      sensorFract = 0;
   }

   if(sensorValue < 0)
   {
      sensorValue = NO_TEMPERATURE_DATA;
      sensorFract = 0;
   }

   float result = sensorValue;
   result += float(sensorFract)/100;

  return result;

}

//----------------------------------------------------------------------------------------------------------------
void setup()
{
  #ifdef _DEBUG
	  Serial.begin(115200);
  #endif

	InitTimersSafe();                                  //инициализируем все таймеры, кроме 0,
	hub.attach(ds18b20);
 	SetPinFrequencySafe(PWM_PIN, FREQUENCY);           //устанавливает частоту для указанного pin
	SetPinFrequency(PWM_PIN, FREQUENCY);               //устанавливает частоту для указанного pin
	pwmWrite(PWM_PIN, PWM_VALUE);                     //0-255   используйте эту функцию вместо analogWrite 


}

//----------------------------------------------------------------------------------------------------------------
void loop()
{

	hub.poll();
 /*
	if(hub.hasError()) 
	{
	  hub.printError();
	}
*/
	if (millis() - sensorUpdateTimer >= SENSOR_UPDATE_INTERVAL)
	{
		// Set temp
		float temperature =  ReadSensor();
		ds18b20.setTemperature(temperature);
    sensorUpdateTimer = millis();
	
	}

}

//----------------------------------------------------------------------------------------------------------------
